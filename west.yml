## west.yml
```yaml
manifest:
  defaults:
    remote: upstream
    revision: master

  remotes:
    - name: upstream
      url-base: https://github.com/zephyrproject-rtos
    - name: gerrit
      url-base: ssh://gerrit.syriusrobotics.cn:29418

  projects:
    - name: zephyr
      revision: d780458bc6a16987b3ed3ed86eeee0810395e9f2
      path: zephyr
      import: True

    - name: chameleon/indicator_button_board
      path: application/indicator_button_board
      remote: gerrit

    - name: chameleon/firmware/scanner_board
      path: application/scanner_board
      remote: gerrit

    - name: chameleon/west_extensions
      path: west_extensions
      west-commands: west-commands.yml
      remote: gerrit

    - name: chameleon/ci
      path: ci
      remote: gerrit

  self:
    path: .manifest-repository
```
